## board/dell/Kconfig
```kconfig
# SPDX-License-Identifier: GPL-2.0+

if VENDOR_DELL

choice
	prompt "Mainboard model"
	optional

config TARGET_VENUE7_3740
	bool "Venue 7 3740"
	help
	  This is the Dell Venue 7 3740 tablet. It contains a dual core Intel
	  Atom Tangier CPU, 1 GB RAM integrated on package. There is also 8 or
	  16 GB eMMC flash on board, Wi-Fi, Bluetooth 4 and USB controllers.

endchoice

source "board/dell/venue7-3740/Kconfig"

endif
```

## board/dell/venue7-3740/Kconfig
```kconfig
if TARGET_VENUE7_3740

config SYS_BOARD
	default "venue7-3740"

config SYS_VENDOR
	default "dell"

config SYS_SOC
	default "tangier"

config SYS_CONFIG_NAME
	default "dell-venue7-3740"

config SYS_MALLOC_LEN
	default 0x08000000

config SYS_TEXT_BASE
	default 0x01101000

config ROM_TABLE_ADDR
	default 0x0e4500

config ROM_TABLE_SIZE
	default 0x007b00

config BOARD_SPECIFIC_OPTIONS # dummy
	def_bool y
	select X86_LOAD_FROM_32_BIT
	select INTEL_MID
	select INTEL_TANGIER

endif
```

## configs/edison_defconfig
```kconfig
CONFIG_X86=y
CONFIG_SMP=y
CONFIG_VENDOR_INTEL=y
CONFIG_DEFAULT_DEVICE_TREE="edison"
CONFIG_TARGET_EDISON=y
# CONFIG_ARCH_EARLY_INIT_R is not set
# CONFIG_BOARD_EARLY_INIT_F is not set
CONFIG_HUSH_PARSER=y
CONFIG_CMD_CPU=y
# CONFIG_CMD_IMLS is not set
# CONFIG_CMD_FLASH is not set
CONFIG_CMD_GPT=y
CONFIG_CMD_MMC=y
CONFIG_CMD_PART=y
CONFIG_CMD_DFU=y
# CONFIG_CMD_SETEXPR is not set
# CONFIG_CMD_NFS is not set
CONFIG_OF_CONTROL=y
CONFIG_OF_EMBED=y
CONFIG_REGMAP=y
CONFIG_SYSCON=y
CONFIG_CPU=y
CONFIG_DFU_MMC=y
CONFIG_DFU_RAM=y
CONFIG_DFU_TIMEOUT=y
CONFIG_MMC=y
CONFIG_DM_MMC=y
CONFIG_MMC_SDHCI=y
CONFIG_MMC_SDHCI_SDMA=y
CONFIG_MMC_SDHCI_TANGIER=y
CONFIG_DM_PCI=y
CONFIG_DM_PCI_COMPAT=y
CONFIG_DM_RTC=y
CONFIG_INTEL_MID_SERIAL=y
CONFIG_TANGIER_WATCHDOG=y
CONFIG_TIMER=y
CONFIG_USE_PRIVATE_LIBGCC=y
CONFIG_SHA1=y
```
